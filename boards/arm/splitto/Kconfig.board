## boards/arm/splitto/Kconfig.board
```kconfig
#
# Copyright (c) 2023 The ZMK Contributors
# SPDX-License-Identifier: MIT
#

config BOARD_SPLITTO_LEFT
    bool "splitto_left"
    depends on SOC_NRF52840_QIAA
    select ZMK_BOARD_COMPAT
    imply RETAINED_MEM
    imply RETENTION
    imply RETENTION_BOOT_MODE

config BOARD_SPLITTO_RIGHT
    bool "splitto_right"
    depends on SOC_NRF52840_QIAA
    select ZMK_BOARD_COMPAT
    imply RETAINED_MEM
    imply RETENTION
    imply RETENTION_BOOT_MODE
```

## boards/arm/splitto/Kconfig.defconfig
```kconfig
if BOARD_SPLITTO_LEFT

# Name must be less than 16 characters long!
config ZMK_KEYBOARD_NAME
    default "Splitto kb"

config ZMK_SPLIT_ROLE_CENTRAL
    default y

endif # LEFT

if BOARD_SPLITTO_LEFT || BOARD_SPLITTO_RIGHT

config BOARD
    default "splitto"

config ZMK_SPLIT
    default y

config BT_CTLR
    default BT

if USB

config USB_NRFX
    default y

config USB_DEVICE_STACK
    default y

endif # USB

endif # LEFT or RIGHT
```

## boards/arm/splitto/splitto_right_defconfig
```kconfig
#
# Copyright (c) 2023 The ZMK Contributors
# SPDX-License-Identifier: MIT
#

CONFIG_BOARD_SPLITTO_RIGHT=y

CONFIG_SOC_SERIES_NRF52X=y
CONFIG_SOC_NRF52840_QIAA=y

# Enable MPU
CONFIG_ARM_MPU=y

# Enable GPIO
CONFIG_PINCTRL=y
CONFIG_GPIO=y

# Build Config
CONFIG_BUILD_OUTPUT_UF2=y
CONFIG_USE_DT_CODE_PARTITION=y

# Writing to flash
CONFIG_MPU_ALLOW_FLASH_WRITE=y
CONFIG_NVS=y
CONFIG_SETTINGS_NVS=y
CONFIG_FLASH=y
CONFIG_FLASH_PAGE_LAYOUT=y
CONFIG_FLASH_MAP=y

# Enable 32kHz crystal
# CONFIG_CLOCK_CONTROL_NRF_K32SRC_XTAL=y
# CONFIG_CLOCK_CONTROL_NRF_K32SRC_150PPM=y

# Bluetooth Connection
# CONFIG_BT_CTLR_TX_PWR_PLUS_8=y
CONFIG_BT_MAX_CONN=4
CONFIG_BT_MAX_PAIRED=4

# This is new with Zephyr 3.5 and should improve connectivity
CONFIG_ZMK_BLE_EXPERIMENTAL_CONN=y
CONFIG_ZMK_HID_REPORT_TYPE_NKRO=y
CONFIG_ZMK_HID_CONSUMER_REPORT_USAGES_BASIC=y

CONFIG_ZMK_USB=y
CONFIG_ZMK_BLE=y

# RGB Lighting
CONFIG_SPI=y
CONFIG_LED_STRIP=y
CONFIG_WS2812_STRIP=y

CONFIG_ZMK_RGB_UNDERGLOW=y
CONFIG_ZMK_RGB_UNDERGLOW_ON_START=y
CONFIG_ZMK_RGB_UNDERGLOW_HUE_START=160
CONFIG_ZMK_RGB_UNDERGLOW_EFF_START=3
CONFIG_ZMK_RGB_UNDERGLOW_BRT_START=50
# CONFIG_ZMK_RGB_UNDERGLOW_BRT_MAX=50
CONFIG_ZMK_RGB_UNDERGLOW_AUTO_OFF_IDLE=y

# Sleep Settings
CONFIG_ZMK_SLEEP=y
CONFIG_ZMK_IDLE_TIMEOUT=15000
CONFIG_ZMK_IDLE_SLEEP_TIMEOUT=1800000

# Enable control of external power (i.e. to LEDs)
CONFIG_ZMK_EXT_POWER=y
# CONFIG_ZMK_RGB_UNDERGLOW_AUTO_OFF_USB=y
```
